## app/boards/shields/66key/Kconfig.defconfig
```kconfig
# Copyright (c) 2020 The ZMK Contributors
# SPDX-License-Identifier: MIT

if SHIELD_66KEY

config ZMK_KEYBOARD_NAME
	default "66key"

endif
```

## app/boards/shields/66key/Kconfig.shield
```kconfig
# Copyright (c) 2020 The ZMK Contributors
# SPDX-License-Identifier: MIT

config SHIELD_66KEY
	def_bool $(shields_list_contains,66key)
```

## app/boards/shields/key66/Kconfig.defconfig
```kconfig
# Copyright (c) 2020 The ZMK Contributors
# SPDX-License-Identifier: MIT

if SHIELD_KEY66

config ZMK_KEYBOARD_NAME
	default "key66"

endif
```

## app/boards/shields/key66/Kconfig.shield
```kconfig
# Copyright (c) 2020 The ZMK Contributors
# SPDX-License-Identifier: MIT

config SHIELD_KEY66
	def_bool $(shields_list_contains,key66)
```
